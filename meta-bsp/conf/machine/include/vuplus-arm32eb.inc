## meta-bsp/conf/machine/include/vuplus-arm32eb.inc
```bitbake
# vuplus-arm32eb.inc

VUPLUS_KERNEL_VERSION ?= "3.14.28"

#Big Endian
#TARGET_ARCH = "armeb"
#DEFAULTTUNE = "armv7ab"

#Little Endian
TARGET_ARCH = "arm"

#DEFAULTTUNE = "armv7a"
#DEFAULTTUNE = "armv7ahf"
DEFAULTTUNE = "armv7ahf-neon"

require conf/machine/include/vuplus.inc
require conf/machine/include/arm/arch-armv7a.inc

VUPLUS_FEATURES += "turbo2"
```

## meta-bsp/conf/machine/vuduo2.conf
```bitbake
#@TYPE: Machine
#@NAME: Vu+ duo2
#@DESCRIPTION: Machine configuration for Vu+ duo2.

VUPLUS_FEATURES += "vuwlan"
VUPLUS_FEATURES += "display-graphic-vfd"
VUPLUS_FEATURES += "enable-rc-kbd"
VUPLUS_FEATURES += "fan_manual rc_code "

VUPLUS_FEATURES += "firmwareupgrade"
VUPLUS_FEATURES += "blindscan"
VUPLUS_FEATURES += "hbbtv"
VUPLUS_FEATURES += "streamtv"
VUPLUS_FEATURES += "dlna"
VUPLUS_FEATURES += "3gmodem"
VUPLUS_FEATURES += "autoshutdown"
VUPLUS_FEATURES += "transcoding"
VUPLUS_FEATURES += "webmanual"
VUPLUS_FEATURES += "wol"
VUPLUS_FEATURES += "audioeffect"
VUPLUS_FEATURES += "dvbproxy"
VUPLUS_FEATURES += "uianimation"
VUPLUS_FEATURES += "kodi"
VUPLUS_FEATURES += "turbo2"

IMAGE_UNPACK_PATH = "vuplus/duo2"
MKFS_UBI_MAX_ERASE_BLK_COUNT = "8192"

require conf/machine/include/vuplus-ubi-splash-initrd.inc
require conf/machine/include/vuplus-mips32el.inc

VUPLUS_KERNEL_VERSION = "3.13.5"
```

## meta-bsp/conf/machine/vuduo4kse.conf
```bitbake
#@TYPE: Machine
#@NAME: Vu+ Duo4kSe
#@DESCRIPTION: Machine configuration for Vu+ Duo4kSe.

VUPLUS_FEATURES += "vuwlan"
VUPLUS_FEATURES += "display-graphic-vfd"
VUPLUS_FEATURES += "enable-rc-kbd"
VUPLUS_FEATURES += "rc_code "

VUPLUS_FEATURES += "blindscan"
VUPLUS_FEATURES += "webmanual"
VUPLUS_FEATURES += "webkithbbtv"
VUPLUS_FEATURES += "streamtv"
VUPLUS_FEATURES += "dlna"
VUPLUS_FEATURES += "3gmodem"
VUPLUS_FEATURES += "autoshutdown"
VUPLUS_FEATURES += "transcoding"
VUPLUS_FEATURES += "audioeffect"
VUPLUS_FEATURES += "dvbproxy"
VUPLUS_FEATURES += "uianimation"
VUPLUS_FEATURES += "kodi"
VUPLUS_FEATURES += "minitv"
VUPLUS_FEATURES += "chromiumos"
VUPLUS_FEATURES += "fcc"
VUPLUS_FEATURES += "bluetooth"
VUPLUS_FEATURES += "scrambledplayback"
VUPLUS_FEATURES += "quadpip"

IMAGE_UNPACK_PATH = "vuplus/duo4kse"
MKFS_UBI_MAX_ERASE_BLK_COUNT = "4096"

require conf/machine/include/vuplus-bz2-splash-initrd.inc
require conf/machine/include/vuplus-arm32eb.inc

LINUXLIBCVERSION = "4.1.45"
VUPLUS_KERNEL_VERSION = "4.1.45"

DEV_KERNEL = "mmcblk0p6"

PREFERRED_VERSION_hmp-usb-dvb-t2-c-arm = "V160430"
```

## meta-bsp/conf/machine/vusolo2.conf
```bitbake
#@TYPE: Machine
#@NAME: Vu+ solo2
#@DESCRIPTION: Machine configuration for Vu+ solo2.

VUPLUS_FEATURES += "vuwlan"
VUPLUS_FEATURES += "display-text-vfd"
VUPLUS_FEATURES += "enable-rc-kbd"
VUPLUS_FEATURES += "fan_manual rc_code "

VUPLUS_FEATURES += "firmwareupgrade"
VUPLUS_FEATURES += "blindscan"
VUPLUS_FEATURES += "webmanual"
VUPLUS_FEATURES += "hbbtv"
VUPLUS_FEATURES += "streamtv"
VUPLUS_FEATURES += "dlna"
VUPLUS_FEATURES += "3gmodem"
VUPLUS_FEATURES += "autoshutdown"
VUPLUS_FEATURES += "transcoding"
VUPLUS_FEATURES += "audioeffect"
VUPLUS_FEATURES += "dvbproxy"
VUPLUS_FEATURES += "uianimation"
VUPLUS_FEATURES += "kodi"
VUPLUS_FEATURES += "turbo2"

IMAGE_UNPACK_PATH = "vuplus/solo2"
MKFS_UBI_MAX_ERASE_BLK_COUNT = "4096"

require conf/machine/include/vuplus-ubi-splash-initrd.inc
require conf/machine/include/vuplus-mips32el.inc

VUPLUS_KERNEL_VERSION = "3.13.5"
```

## meta-bsp/conf/machine/vusolo4k.conf
```bitbake
#@TYPE: Machine
#@NAME: Vu+ solo4k
#@DESCRIPTION: Machine configuration for Vu+ solo4k.

VUPLUS_FEATURES += "vuwlan"
VUPLUS_FEATURES += "display-graphic-vfd"
VUPLUS_FEATURES += "enable-rc-kbd"
VUPLUS_FEATURES += "rc_code "

VUPLUS_FEATURES += "blindscan"
VUPLUS_FEATURES += "webmanual"
VUPLUS_FEATURES += "webkithbbtv"
VUPLUS_FEATURES += "streamtv"
VUPLUS_FEATURES += "dlna"
VUPLUS_FEATURES += "3gmodem"
VUPLUS_FEATURES += "autoshutdown"
VUPLUS_FEATURES += "transcoding"
VUPLUS_FEATURES += "audioeffect"
VUPLUS_FEATURES += "dvbproxy"
VUPLUS_FEATURES += "uianimation"
VUPLUS_FEATURES += "kodi"
VUPLUS_FEATURES += "minitv"
VUPLUS_FEATURES += "chromiumos"
VUPLUS_FEATURES += "fcc"
VUPLUS_FEATURES += "scrambledplayback"
VUPLUS_FEATURES += "quadpip"
VUPLUS_FEATURES += "bluetooth"

IMAGE_UNPACK_PATH = "vuplus/solo4k"
MKFS_UBI_MAX_ERASE_BLK_COUNT = "4096"

require conf/machine/include/vuplus-bz2-splash-initrd.inc
require conf/machine/include/vuplus-arm32eb.inc

VUPLUS_KERNEL_VERSION = "3.14.28"

IMAGE_FSTYPES =+ "ext4"
```

## meta-bsp/conf/machine/vusolose.conf
```bitbake
#@TYPE: Machine
#@NAME: Vu+ solose
#@DESCRIPTION: Machine configuration for Vu+ solose.

VUPLUS_FEATURES += "vuwlan"
VUPLUS_FEATURES += "display-text-vfd"
VUPLUS_FEATURES += "enable-rc-kbd"
VUPLUS_FEATURES += "rc_code "

VUPLUS_FEATURES += "blindscan"
VUPLUS_FEATURES += "firmwareupgrade"
VUPLUS_FEATURES += "hbbtv"
VUPLUS_FEATURES += "streamtv"
VUPLUS_FEATURES += "dlna"
VUPLUS_FEATURES += "3gmodem"
VUPLUS_FEATURES += "autoshutdown"
VUPLUS_FEATURES += "transcoding"
VUPLUS_FEATURES += "webmanual"
VUPLUS_FEATURES += "audioeffect"
VUPLUS_FEATURES += "dvbproxy"
VUPLUS_FEATURES += "uianimation"
VUPLUS_FEATURES += "kodi"
VUPLUS_FEATURES += "turbo2"

IMAGE_UNPACK_PATH = "vuplus/solose"
MKFS_UBI_MAX_ERASE_BLK_COUNT = "4096"

require conf/machine/include/vuplus-ubi-splash-initrd-forceupdate.inc
require conf/machine/include/vuplus-mips32el.inc

VUPLUS_KERNEL_VERSION = "3.13.5"
```

## meta-bsp/conf/machine/vuuno4kse.conf
```bitbake
#@TYPE: Machine
#@NAME: Vu+ Uno4K SE
#@DESCRIPTION: Machine configuration for Vu+ Uno4K SE.

VUPLUS_FEATURES += "vuwlan"
VUPLUS_FEATURES += "display-graphic-vfd"
VUPLUS_FEATURES += "enable-rc-kbd"
VUPLUS_FEATURES += "rc_code "

VUPLUS_FEATURES += "blindscan"
VUPLUS_FEATURES += "webmanual"
VUPLUS_FEATURES += "webkithbbtv"
VUPLUS_FEATURES += "streamtv"
VUPLUS_FEATURES += "dlna"
VUPLUS_FEATURES += "3gmodem"
VUPLUS_FEATURES += "autoshutdown"
VUPLUS_FEATURES += "transcoding"
VUPLUS_FEATURES += "audioeffect"
VUPLUS_FEATURES += "dvbproxy"
VUPLUS_FEATURES += "uianimation"
VUPLUS_FEATURES += "kodi"
VUPLUS_FEATURES += "minitv"
VUPLUS_FEATURES += "chromiumos"
VUPLUS_FEATURES += "fcc"
VUPLUS_FEATURES += "bluetooth"
VUPLUS_FEATURES += "quadpip"

IMAGE_UNPACK_PATH = "vuplus/uno4kse"
MKFS_UBI_MAX_ERASE_BLK_COUNT = "4096"

require conf/machine/include/vuplus-bz2-splash-initrd.inc
require conf/machine/include/vuplus-arm32eb.inc

LINUXLIBCVERSION = "4.1.20"
VUPLUS_KERNEL_VERSION = "4.1.20"

PREFERRED_VERSION_vuplus-tuner-turbo = "4.1.20-1.5"

IMAGE_FSTYPES =+ "ext4"
```

## meta-bsp/conf/machine/vuzero.conf
```bitbake
#@TYPE: Machine
#@NAME: Vu+ zero
#@DESCRIPTION: Machine configuration for Vu+ zero

VUPLUS_FEATURES += "vuwlan"
VUPLUS_FEATURES += "display-text-vfd"
VUPLUS_FEATURES += "enable-rc-kbd"
VUPLUS_FEATURES += "rc_code "

VUPLUS_FEATURES += "firmwareupgrade"
VUPLUS_FEATURES += "hbbtv"
VUPLUS_FEATURES += "streamtv"
VUPLUS_FEATURES += "dlna"
VUPLUS_FEATURES += "3gmodem"
VUPLUS_FEATURES += "autoshutdown"
VUPLUS_FEATURES += "webmanual"
VUPLUS_FEATURES += "audioeffect"
VUPLUS_FEATURES += "turbo2"

IMAGE_UNPACK_PATH = "vuplus/zero"
MKFS_UBI_MAX_ERASE_BLK_COUNT = "4096"

require conf/machine/include/vuplus-ubi-splash-initrd-forceupdate.inc
require conf/machine/include/vuplus-mips32el.inc

VUPLUS_KERNEL_VERSION = "3.13.5"
```

## meta-bsp/conf/machine/vuzero4k.conf
```bitbake
#@TYPE: Machine
#@NAME: Vu+ Zero4k
#@DESCRIPTION: Machine configuration for Vu+ Zero4k.

VUPLUS_FEATURES += "vuwlan"
VUPLUS_FEATURES += "display-text-vfd"
VUPLUS_FEATURES += "enable-rc-kbd"
VUPLUS_FEATURES += "rc_code "

VUPLUS_FEATURES += "blindscan"
VUPLUS_FEATURES += "webmanual"
VUPLUS_FEATURES += "webkithbbtv"
VUPLUS_FEATURES += "streamtv"
VUPLUS_FEATURES += "dlna"
VUPLUS_FEATURES += "3gmodem"
VUPLUS_FEATURES += "autoshutdown"
VUPLUS_FEATURES += "audioeffect"
VUPLUS_FEATURES += "dvbproxy"
VUPLUS_FEATURES += "uianimation"
VUPLUS_FEATURES += "kodi"
VUPLUS_FEATURES += "chromiumos"
VUPLUS_FEATURES += "bluetooth"

IMAGE_UNPACK_PATH = "vuplus/zero4k"
MKFS_UBI_MAX_ERASE_BLK_COUNT = "4096"

require conf/machine/include/vuplus-bz2-splash-initrd-forceupdate.inc
require conf/machine/include/vuplus-arm32eb.inc

LINUXLIBCVERSION = "4.1.20"
VUPLUS_KERNEL_VERSION = "4.1.20"

PREFERRED_VERSION_vuplus-tuner-turbo = "4.1.20-1.5"

IMAGE_FSTYPES =+ "ext4"
```

## meta-openvuplus/conf/distro/reporefs.conf
```bitbake
# wlan
SRCREV_pn-firmware-rtl8192eu ??= "4b2b151e1842d172e76c2e0a6bfa1f4284a5e344"
SRCREV_pn-rtl8192eu ??= "0af336b999ff9b29477a205117410f9947a58fdd"
```

## meta-openvuplus/conf/distro/vuplus.conf
```bitbake
#@TYPE: Distribution
#@NAME: OpenVuplus
#@DESCRIPTION: Distribution configuration for OpenVuplus

require reporefs.conf

QA_LOGFILE = "${TMPDIR}/qa.log"
#USER_CLASSES += "image-prelink"
SANITY_REQUIRED_UTILITIES = "patch diffstat texi2html makeinfo svn bzip2 tar gzip gawk chrpath wget cpio sshpass glib-mkenums"
INHERIT += "buildhistory recipe_sanity"
BUILDHISTORY_COMMIT = "1"

DISTRO = "vuplus"
DISTRO_NAME = "vuplus"
DISTRO_VERSION = "3.0.0"
DISTRO_PR ?= ""

# meta/conf/distro/include/default-distrovars.inc
DISTRO_FEATURES += "3g alsa bluetooth directfb gtk-directfb ext2 largefile mplt nfs pci ppp smbfs usbhost zeroconf pci ${DISTRO_FEATURES_LIBC}"
DISTRO_FEATURES_BACKFILL_CONSIDERED = "pulseaudio"

# extra packages needed if opkg is used
DISTRO_FEED_PREFIX ?= "official"
DISTRO_FEED_URI ?= "http://code.vuplus.com/packages/openvuplus/${DISTRO_VERSION}/vuplus/feeds/stable"
EXTRAOPKGCONFIG = "distro-feed-configs"

# meta/recipes-core/sysvinit/sysvinit-inittab_2.88dsf.bb
SYSVINIT_ENABLED_GETTYS = ""

# meta/classes/image_types.bbclass
IMAGE_FSTYPES =+ "tar.bz2"

# package versions
GST_VERSION = "1.0"

PREFERRED_VERSION_freetype ?= "2.4.12"

PREFERRED_VERSION_udev ?= "182"

PREFERRED_VERSION_elfutils ?= "0.148"

PREFERRED_VERSION_libmicrohttpd ?= "0.9.34"
PREFERRED_VERSION_libdvdcss ?= "1.2.10"
#PREFERRED_VERSION_taglib ?= "1.8"

PREFERRED_PROVIDER_jpeg = "jpeg"
PREFERRED_PROVIDER_jpeg-native = "jpeg-native"
PREFERRED_PROVIDER_libfribidi = "libfribidi"

PREFERRED_PROVIDERS += "virtual/${TARGET_PREFIX}gcc-initial:gcc-cross-initial"
PREFERRED_PROVIDERS += "virtual/${TARGET_PREFIX}gcc-intermediate:gcc-cross-intermediate"
PREFERRED_PROVIDERS += "virtual/${TARGET_PREFIX}gcc:gcc-cross"
PREFERRED_PROVIDERS += "virtual/${TARGET_PREFIX}g++:gcc-cross"

LICENSE_FLAGS_WHITELIST = "commercial_gst-plugins-ugly commercial_lame commercial_libmad commercial_mpeg2dec commercial_libav commercial_minidlna"
LICENSE_FLAGS_WHITELIST += "commercial_gstreamer1.0-plugins-ugly"

FULL_OPTIMIZATION = "-Os -pipe ${DEBUG_FLAGS}"
# build some core libs with better compiler optimization for better performance
O3_OPT = "-O3 -pipe ${DEBUG_FLAGS}"
FULL_OPTIMIZATION_pn-flac = "${O3_OPT}"
FULL_OPTIMIZATION_pn-jpeg = "${O3_OPT}"
FULL_OPTIMIZATION_pn-lame = "${O3_OPT}"
FULL_OPTIMIZATION_pn-liba52 = "${O3_OPT}"
FULL_OPTIMIZATION_pn-libdca = "${O3_OPT}"
FULL_OPTIMIZATION_pn-libgcrypt = "${O3_OPT}"
FULL_OPTIMIZATION_pn-libmad = "${O3_OPT}"
FULL_OPTIMIZATION_pn-libogg = "${O3_OPT}"
FULL_OPTIMIZATION_pn-libpng = "${O3_OPT}"
FULL_OPTIMIZATION_pn-libsamplerate = "${O3_OPT}"
FULL_OPTIMIZATION_pn-libvorbis = "${O3_OPT}"
FULL_OPTIMIZATION_pn-tremor = "${O3_OPT}"
FULL_OPTIMIZATION_pn-zlib = "${O3_OPT}"
PR_append_pn-flac = "-opt1"
PR_append_pn-jpeg = "-opt1"
PR_append_pn-lame = "-opt1"
PR_append_pn-liba52 = "-opt1"
PR_append_pn-libdca = "-opt1"
PR_append_pn-libgcrypt = "-opt1"
PR_append_pn-libmad = "-opt1"
PR_append_pn-libogg = "-opt1"
PR_append_pn-libpng = "-opt1"
PR_append_pn-libsamplerate = "-opt1"
PR_append_pn-libvorbis = "-opt1"
PR_append_pn-tremor = "-opt1"
PR_append_pn-zlib = "-opt1"

# Disable installing ldconfig
USE_LDCONFIG = "0"

TCLIBCAPPEND = ""

# Drop unused PACKAGE_EXTRA_ARCHS
PACKAGE_EXTRA_ARCHS = "${TUNE_PKGARCH}"

QEMU_TARGETS ?= "mipsel"

PREMIRRORS ?= "\
bzr://.*/.*   http://archive.vuplus.com/openvuplus_mirror_30/ \n \
cvs://.*/.*   http://archive.vuplus.com/openvuplus_mirror_30/ \n \
git://.*/.*   http://archive.vuplus.com/openvuplus_mirror_30/ \n \
hg://.*/.*    http://archive.vuplus.com/openvuplus_mirror_30/ \n \
osc://.*/.*   http://archive.vuplus.com/openvuplus_mirror_30/ \n \
p4://.*/.*    http://archive.vuplus.com/openvuplus_mirror_30/ \n \
svn://.*/.*   http://archive.vuplus.com/openvuplus_mirror_30/ \n \
bzr://.*/.*   http://autobuilder.yoctoproject.org/sources/ \n \
cvs://.*/.*   http://autobuilder.yoctoproject.org/sources/ \n \
git://.*/.*   http://autobuilder.yoctoproject.org/sources/ \n \
hg://.*/.*    http://autobuilder.yoctoproject.org/sources/ \n \
osc://.*/.*   http://autobuilder.yoctoproject.org/sources/ \n \
p4://.*/.*    http://autobuilder.yoctoproject.org/sources/ \n \
svn://.*/.*   http://autobuilder.yoctoproject.org/sources/ \n"

MIRRORS =+ "\
ftp://.*/.*    http://archive.vuplus.com/openvuplus_mirror_30/ \n \
http://.*/.*   http://archive.vuplus.com/openvuplus_mirror_30/ \n \
https://.*/.*  http://archive.vuplus.com/openvuplus_mirror_30/ \n \
ftp://.*/.*    http://autobuilder.yoctoproject.org/sources/ \n \
http://.*/.*   http://autobuilder.yoctoproject.org/sources/ \n \
https://.*/.*  http://autobuilder.yoctoproject.org/sources/ \n"

# for compatibility with rm_old_work.bbclass
WORKDIR = "${TMPDIR}/work/${MULTIMACH_TARGET_SYS}/${PN}/${PF}"
```
